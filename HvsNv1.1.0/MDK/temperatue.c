#include "stm32f4xx.h"
#include "adc.h"

u8 	TempretureCheckFlag = 0;
s32 	TempAtPa0,TempAtPf8,TempAtPf9,TempAtPf10;

/////////////////////��������
#define	Res1	4700	//4.7K
#define	BValue	3950
float 	Rt;
#define TEMP_NUM   241
int  nuiTempTab[TEMP_NUM]=
{
	95337,92655,90058,87540,85100,82736,80444,78222,76068,73980,
	71955,69992,68088,66241,64449,62712,61026,59390,57803,56263,
	54769,53318,51911,50544,49217,47929,46679,45464,44285,43140,
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	672,663, 
	  
};

int trueTempTab[TEMP_NUM]=
{
	-200,-195,-190,-185,-180,-175,-170,-165,-160,-155,
	-150,-145,-140,-135,-130,-125,-120,-115,-110,-105,
	-100,-95,-90,-85,-80,-75,-70,-65,-60,-55,-50,-45,
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	955,960,965,970,975,980,985,990,995,1000,
};

int CalcTemp(int nuiResVal)
{
	int temperature;
	int k;
	int m;
	int nuiTempMin = 0;
	int nuiTempMax = TEMP_NUM;
	int nuiMidVal = 0;

	while(nuiResVal >= nuiTempTab[nuiTempMax])
	{
		nuiMidVal = (nuiTempMax + nuiTempMin) / 2;
		if((nuiMidVal == nuiTempMin) || (nuiMidVal == nuiTempMax))
		{
			break;
		}
		if(nuiResVal >= nuiTempTab[nuiMidVal])
		{
			nuiTempMax = nuiMidVal;
		}
		else
		{
			nuiTempMin = nuiMidVal;
		}
	}
	if (nuiResVal == nuiTempTab[nuiTempMin])
	{
		return trueTempTab[nuiTempMin];
	}
	if (nuiResVal == nuiTempTab[nuiTempMax])
	{
		return trueTempTab[nuiTempMax];
	}
	k = nuiTempTab[nuiTempMin] - nuiTempTab[nuiTempMax];

	m = (trueTempTab[nuiTempMax] - trueTempTab[nuiTempMin]) * (nuiResVal - nuiTempTab[nuiTempMax]) / k;
	temperature = trueTempTab[nuiTempMin] +  m;

	return temperature;
} 
/////////////////////

u8 TemperetureCheckAndActions(void)
{
	u8 ret = 0;
	u16 tt;
	
	tt = Get_Adc3_Average(ADC_Channel_8,ADC_GETAVERAGE_K);
	Rt=(float)tt*(3.3/4096);
	Rt=(Res1*(float)tt)/(4096-(float)tt);
	TempAtPf10 = CalcTemp(Rt);			
	if(TempAtPf10 > TEMPLIMITVALUE){
		ret |= 1<<0;
		//LED_DisResOT_ON;
	}
	tt = Get_Adc3_Average(ADC_Channel_7,ADC_GETAVERAGE_K);
	Rt=(Res1*(float)tt)/(4096-(float)tt);
	TempAtPf9 = CalcTemp(Rt);			
	if(TempAtPf9 > TEMPLIMITVALUE){
		ret |= 1<<1;
		//LED_PreResOT_ON;
	}
	tt = Get_Adc3_Average(ADC_Channel_6,ADC_GETAVERAGE_K);
	Rt=(Res1*(float)tt)/(4096-(float)tt);
	TempAtPf8 = CalcTemp(Rt);			
	if(TempAtPf8 > TEMPLIMITVALUE){
		ret |= 1<<2;
		//LED_PreResOT_ON;
	}
	
	return ret;
}
















































